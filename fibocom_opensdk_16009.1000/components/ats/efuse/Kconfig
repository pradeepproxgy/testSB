## fibocom_opensdk_16009.1000/components/ats/efuse/Kconfig
```kconfig
# Copyright (C) 2018 RDA Technologies Limited and/or its affiliates("RDA").
# All rights reserved.
#
# This software is supplied "AS IS" without any warranties.
# RDA assumes no responsibility or liability for the use of the software,
# conveys no license or title under any patent, copyright, or mask work
# right to the product. RDA reserves the right to make changes in the
# software without notification.  RDA also make no representation or
# warranty that such application will be suitable for the specified use
# without further testing or modification.

menu "at_efuse"

config AT_EFUSEID_SUPPORT
    bool "EFUSEID_SUPPORT enabled"
    default y if SOC_8850
    default n
    help
        when enabled, AT command EFUSEID is supported

endmenu
```

## fibocom_opensdk_16009.1000/components/ats/gc/Kconfig
```kconfig
# Copyright (C) 2018 RDA Technologies Limited and/or its affiliates("RDA").
# All rights reserved.
#
# This software is supplied "AS IS" without any warranties.
# RDA assumes no responsibility or liability for the use of the software,
# conveys no license or title under any patent, copyright, or mask work
# right to the product. RDA reserves the right to make changes in the
# software without notification.  RDA also make no representation or
# warranty that such application will be suitable for the specified use
# without further testing or modification.

menu "at_gc"

config AT_GC_COMMAND_SUPPORT
    bool "AT_GC_COMMAND_SUPPORT enabled"
    default y
    select GC_COMMAND_SUPPORT
    help
        When enabled, some at command can be used, ie ATS0
config AT_CCLK_COMMAND_STYLE_NEW
    bool "AT_CCLK_COMMAND_STYLE_NEW enabled"
    default n
    select CCLK_COMMAND_STYLE_NEW
    help
        When enabled, CCLK return will use new style, only return the real clock after getting from the network
config AT_PM2_DISABLE
    bool "AT_PM2_DISABLE"
    default n
    select CONFIG_AT_PM2_DISABLE

config SHARE_SIM_SUPPORT
    bool "SHARE_SIM_SUPPORT enabled"
    default n
    help
        Enable Share sim card feature

endmenu
```

## fibocom_opensdk_16009.1000/components/ats/ids/Kconfig
```kconfig
# Copyright (C) 2018 RDA Technologies Limited and/or its affiliates("RDA").
# All rights reserved.
#
# This software is supplied "AS IS" without any warranties.
# RDA assumes no responsibility or liability for the use of the software,
# conveys no license or title under any patent, copyright, or mask work
# right to the product. RDA reserves the right to make changes in the
# software without notification.  RDA also make no representation or
# warranty that such application will be suitable for the specified use
# without further testing or modification.

menu "at_ids"

config AT_IDS_SUPPORT
    bool "AT IDS support"
    default y if SOC_8910 || SOC_8850
    default n
	depends on NET_IDS_SUPPORT
    help
        when enabled, AT command IDS is supported

endmenu
```

## fibocom_opensdk_16009.1000/components/ats/unikey/Kconfig
```kconfig
# Copyright (C) 2020 RDA Technologies Limited and/or its affiliates("RDA").
# All rights reserved.
#
# This software is supplied "AS IS" without any warranties.
# RDA assumes no responsibility or liability for the use of the software,
# conveys no license or title under any patent, copyright, or mask work
# right to the product. RDA reserves the right to make changes in the
# software without notification.  RDA also make no representation or
# warranty that such application will be suitable for the specified use
# without further testing or modification.

menu "at_unikey"

config AT_UNIKEY_SUPPORT
    bool "AT_UNIKEY_SUPPORT enabled"
    #default y if SOC_8910 || SOC_8850
    default y if SOC_8910  #modify by fibocom
    default n
    depends on NET_LIBDMP_SDK_SUPPORT
    help
        When enabled, CONFIG_AT_UNIKEY_SUPPORT will be defined

endmenu
```

## fibocom_opensdk_16009.1000/components/calclib/Kconfig
```kconfig
# Copyright (C) 2018 RDA Technologies Limited and/or its affiliates("RDA").
# All rights reserved.
#
# This software is supplied "AS IS" without any warranties.
# RDA assumes no responsibility or liability for the use of the software,
# conveys no license or title under any patent, copyright, or mask work
# right to the product. RDA reserves the right to make changes in the
# software without notification.  RDA also make no representation or
# warranty that such application will be suitable for the specified use
# without further testing or modification.

menu "calc"

config SIMAGE_HEADER_SM3_SUPPORT
    bool "simage header hash sm3 type support"
    default n
    help
        This is the hash type of simage header.

endmenu
```

## fibocom_opensdk_16009.1000/components/halo_rec/Kconfig
```kconfig
# Copyright (C) 2018 RDA Technologies Limited and/or its affiliates("RDA").
# All rights reserved.
#
# This software is supplied "AS IS" without any warranties.
# RDA assumes no responsibility or liability for the use of the software,
# conveys no license or title under any patent, copyright, or mask work
# right to the product. RDA reserves the right to make changes in the
# software without notification.  RDA also make no representation or
# warranty that such application will be suitable for the specified use
# without further testing or modification.

menu "halo_rec"

config HALO_SUPPORT
    bool "HALO_SUPPORT enabled"
    default n
    help
        When enabled, HALO_SUPPORT will be defined

config HALO_V1_SUPPORT
    bool "HALO_V1_SUPPORT enabled"
    default n
    help
        When enabled, HALO_V1_SUPPORT will be defined

endmenu
```

## fibocom_opensdk_16009.1000/components/ml/Kconfig
```kconfig
# Copyright (C) 2018 RDA Technologies Limited and/or its affiliates("RDA").
# All rights reserved.
#
# This software is supplied "AS IS" without any warranties.
# RDA assumes no responsibility or liability for the use of the software,
# conveys no license or title under any patent, copyright, or mask work
# right to the product. RDA reserves the right to make changes in the
# software without notification.  RDA also make no representation or
# warranty that such application will be suitable for the specified use
# without further testing or modification.

menu "ML"

config ML_SUPPORT_CP936
    bool "Enable/disable CP936 character set"
    default n if SOC_8811
    default y

endmenu
```

## fibocom_opensdk_16009.1000/components/net/mbedtls/Kconfig
```kconfig
# Copyright (C) 2018 RDA Technologies Limited and/or its affiliates("RDA").
# All rights reserved.
#
# This software is supplied "AS IS" without any warranties.
# RDA assumes no responsibility or liability for the use of the software,
# conveys no license or title under any patent, copyright, or mask work
# right to the product. RDA reserves the right to make changes in the
# software without notification.  RDA also make no representation or
# warranty that such application will be suitable for the specified use
# without further testing or modification.

menu "mbedtls"
config MBEDTLS_REDUCE_MEMORY
    bool "MBEDTLS_REDUCE_MEMORY enabled"
    depends on MBEDTLS_LIB_SUPPORT
    default n
    help
        When enabled, MBEDTLS_REDUCE_MEMORY will be defined
config MBEDTLS_LITE_CRYPTS
    bool "MBEDTLS_LITE_CRYPTS enabled"
    depends on MBEDTLS_LIB_SUPPORT
    default n
    help
        When enabled, MBEDTLS_LITE_CRYPTS will be defined
config MBEDTLS_SSL_TLS
    bool "MBEDTLS_SSL_TLS enabled"
    depends on MBEDTLS_LIB_SUPPORT
    default y
    help
        When enabled, MBEDTLS_SSL_TLS will be defined, if select more than one version ,the version must be continuous
config MBEDTLS_SSL_VERSION_SSL3
    bool "MBEDTLS_SSL_VERSION_SSL3 enabled"
    depends on MBEDTLS_SSL_TLS
    default y
    help
        When enabled, MBEDTLS_SSL_VERSION_SSL3 will be defined
config MBEDTLS_SSL_VERSION_TLS1_0
    bool "MBEDTLS_SSL_VERSION_TLS1_0 enabled"
    depends on MBEDTLS_SSL_TLS
    default y
    help
        When enabled, MBEDTLS_SSL_VERSION_TLS1_0 will be defined
config MBEDTLS_SSL_VERSION_TLS1_1
    bool "MBEDTLS_SSL_VERSION_TLS1_1 enabled"
    depends on MBEDTLS_SSL_TLS
    default y
    help
        When enabled, MBEDTLS_SSL_VERSION_TLS1_1 will be defined
config MBEDTLS_SSL_VERSION_TLS1_2
    bool "MBEDTLS_SSL_VERSION_TLS1_2 enabled"
    depends on MBEDTLS_SSL_TLS
    default y
    help
        When enabled, MBEDTLS_SSL_VERSION_TLS1_2 will be defined
config MBEDTLS_SSL_VERSION_DTLS
    bool "MBEDTLS_SSL_VERSION_DTLS enabled"
    depends on MBEDTLS_SSL_TLS
    depends on (MBEDTLS_SSL_VERSION_TLS1_1 || MBEDTLS_SSL_VERSION_TLS1_2)
    default y
    help
        When enabled, MBEDTLS_SSL_VERSION_DTLS will be defined
config MBEDTLS_SELF_TEST
    bool "MBEDTLS_SELF_TEST enabled"
    depends on MBEDTLS_LIB_SUPPORT
    default n
    help
        When enabled, MBEDTLS_SELF_TEST will be defined
config MBEDTLS_SUPPORT_ECP
    bool "MBEDTLS_SUPPORT_ECP enabled"
    depends on MBEDTLS_LIB_SUPPORT
    default y
    help
        When enabled, MBEDTLS_SUPPORT_ECP will be defined
config MBEDTLS_SUPPORT_SM2
    bool "MBEDTLS_SUPPORT_SM2 enabled"
    depends on MBEDTLS_LIB_SUPPORT
    depends on MBEDTLS_SUPPORT_ECP
    default y
    help
        When enabled, MBEDTLS_SUPPORT_SM2 will be defined
config MBEDTLS_SUPPORT_ECDSA_DETERMINISTIC
    bool "MBEDTLS_SUPPORT_ECDSA_DETERMINISTIC enabled"
    depends on MBEDTLS_LIB_SUPPORT
    default y
    help
        When enabled, MBEDTLS_SUPPORT_ECDSA_DETERMINISTIC will be defined
config MBEDTLS_SUPPORT_KEY_EXCHANGE_DHE_PSK
    bool "MBEDTLS_SUPPORT_KEY_EXCHANGE_DHE_PSK enabled"
    depends on MBEDTLS_LIB_SUPPORT
    default y
    help
        When enabled, MBEDTLS_SUPPORT_KEY_EXCHANGE_DHE_PSK will be defined
config MBEDTLS_SUPPORT_KEY_EXCHANGE_ECDHE_PSK
    bool "MBEDTLS_SUPPORT_KEY_EXCHANGE_ECDHE_PSK enabled"
    depends on MBEDTLS_LIB_SUPPORT
    default y
    help
        When enabled, MBEDTLS_SUPPORT_KEY_EXCHANGE_ECDHE_PSK will be defined
config MBEDTLS_SUPPORT_KEY_EXCHANGE_RSA_PSK
    bool "MBEDTLS_SUPPORT_KEY_EXCHANGE_RSA_PSK enabled"
    depends on MBEDTLS_LIB_SUPPORT
    default y
    help
        When enabled, MBEDTLS_SUPPORT_KEY_EXCHANGE_RSA_PSK will be defined
config MBEDTLS_SUPPORT_KEY_EXCHANGE_DHE_RSA
    bool "MBEDTLS_SUPPORT_KEY_EXCHANGE_DHE_RSA enabled"
    depends on MBEDTLS_LIB_SUPPORT
    default y
    help
        When enabled, MBEDTLS_SUPPORT_KEY_EXCHANGE_DHE_RSA will be defined
config MBEDTLS_SUPPORT_KEY_EXCHANGE_ECDHE_RSA
    bool "MBEDTLS_SUPPORT_KEY_EXCHANGE_ECDHE_RSA enabled"
    depends on MBEDTLS_LIB_SUPPORT
    default y
    help
        When enabled, MBEDTLS_SUPPORT_KEY_EXCHANGE_ECDHE_RSA will be defined
config MBEDTLS_SUPPORT_KEY_EXCHANGE_ECDHE_ECDSA
    bool "MBEDTLS_SUPPORT_KEY_EXCHANGE_ECDHE_ECDSA enabled"
    depends on MBEDTLS_LIB_SUPPORT
    default y
    help
        When enabled, MBEDTLS_SUPPORT_KEY_EXCHANGE_ECDHE_ECDSA will be defined
config MBEDTLS_SUPPORT_KEY_EXCHANGE_ECDH_ECDSA
    bool "MBEDTLS_SUPPORT_KEY_EXCHANGE_ECDH_ECDSA enabled"
    depends on MBEDTLS_LIB_SUPPORT
    default y
    help
        When enabled, MBEDTLS_SUPPORT_KEY_EXCHANGE_ECDH_ECDSA will be defined
config MBEDTLS_SUPPORT_KEY_EXCHANGE_ECDH_RSA
    bool "MBEDTLS_SUPPORT_KEY_EXCHANGE_ECDH_RSA enabled"
    depends on MBEDTLS_LIB_SUPPORT
    default y
    help
        When enabled, MBEDTLS_SUPPORT_KEY_EXCHANGE_ECDH_RSA will be defined	
endmenu
```

## fibocom_opensdk_16009.1000/components/openCPU/Kconfig
```kconfig
# Copyright (C) 2018 RDA Technologies Limited and/or its affiliates("RDA").
# All rights reserved.
#
# This software is supplied "AS IS" without any warranties.
# RDA assumes no responsibility or liability for the use of the software,
# conveys no license or title under any patent, copyright, or mask work
# right to the product. RDA reserves the right to make changes in the
# software without notification.  RDA also make no representation or
# warranty that such application will be suitable for the specified use
# without further testing or modification.

menu "openCPU"

config OPENCPU_ENABLED
    bool "openCPU enabled"
    default n
    help
        When enabled, the openCPU image at the reserved flash location
        will tried to run independently without OS

if OPENCPU_ENABLED
    config OPENCPU_VERSION
        string "oepnCPU version"
        default "1.0"
        help
            The version string format must be "x.x"

    if SOC_8811
        config OPENCPU_MAIN_STACK_SIZE
            hex "8811 openCPU main stack size"
            default 0x2000
            help
                Main stack size of openCPU.

        config OPENCPU_PROCESS_STACK_SIZE
            hex "8811 openCPU process stack size"
            default 0x2000
            help
                Process stack size of openCPU.

        config OPENCPU_SHARE_MEMORY_SIZE
            hex "8811 openCPU share memory size"
            default 0x2000
            help
                Share memory size of openCPU.
    endif

    if SOC_8850
        config OPENCPU_SYS_STACK_SIZE
            hex "8850 openCPU sys stack size"
            default 0x2000
            help
                sys stack size of openCPU.

        config OPENCPU_IRQ_STACK_SIZE
            hex "8850 openCPU irq stack size"
            default 0x1000
            help
                irq stack size of openCPU.

        config OPENCPU_SHARE_MEMORY_SIZE
            hex "8850 openCPU share memory size"
            default 0x2000
            help
                Share memory size of openCPU.

        config OPENCPU_PSRAM_ENABLE
            bool "8850 openCPU psram enabled"
            default y
            help
                openCPU support psram.
    endif

    choice
        prompt "Share memory Transmition Method"
        default SHARE_MEMORY_USE_SRAM if SOC_8811
        default SHARE_MEMORY_USE_LZ4_FILE if SOC_8850
    
    config SHARE_MEMORY_USE_SRAM
        bool "Use SRAM"
    
    config SHARE_MEMORY_USE_LZ4_FILE
        bool "Use File"
        
    endchoice 

    choice
        prompt "openCPU boot mode"
        default OPENCPU_BOOT_FROM_BOOTLOADER
    config OPENCPU_BOOT_FROM_BOOTLOADER
        bool "boot from bootloader"
    config OPENCPU_BOOT_FROM_AP
        bool "boot from AP"
    endchoice

    choice
        prompt "Trace default UART"
        default OPENCPU_TRACE_DEFAULT_UART3 if SOC_8811
        default OPENCPU_TRACE_DEFAULT_UART4 if SOC_8850

    config OPENCPU_TRACE_DEFAULT_UART1
        bool "UART1"

    config OPENCPU_TRACE_DEFAULT_UART2
        bool "UART2"

    config OPENCPU_TRACE_DEFAULT_UART3
        bool "UART3"

    config OPENCPU_TRACE_DEFAULT_UART4
        bool "UART4"

    config OPENCPU_TRACE_DEFAULT_UART5
        bool "UART5"

    endchoice

    config OPENCPU_TRACE_DEFAULT_UART
        string
        default "DRV_NAME_UART1" if OPENCPU_TRACE_DEFAULT_UART1
        default "DRV_NAME_UART2" if OPENCPU_TRACE_DEFAULT_UART2
        default "DRV_NAME_UART3" if OPENCPU_TRACE_DEFAULT_UART3
        default "DRV_NAME_UART4" if OPENCPU_TRACE_DEFAULT_UART4
        default "DRV_NAME_UART5" if OPENCPU_TRACE_DEFAULT_UART5
        default ""

    config OPENCPU_TRACE_DEFAULT_UART_BAUD
        int "Baud rate of trace default UART"
        default 2000000

    orsource "src/console/Kconfig"

endif

endmenu
```
